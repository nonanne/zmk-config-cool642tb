#include "cool642tb.dtsi"

&kscan0 {
        col-gpios
            = <&xiao_d 10 GPIO_ACTIVE_HIGH>
            , <&xiao_d 9 GPIO_ACTIVE_HIGH>
            , <&xiao_d 8 GPIO_ACTIVE_HIGH>
            , <&xiao_d 7 GPIO_ACTIVE_HIGH>
            , <&gpio0 10 GPIO_ACTIVE_HIGH>
            , <&gpio0 9 GPIO_ACTIVE_HIGH>
            ;
};

&left_encoder {
    status = "okay";
};

CONFIG_ZMK_NON_LIPO_BATTERY_MANAGEMENT=y
CONFIG_ZMK_NON_LIPO_MIN_MV=2000
CONFIG_ZMK_NON_LIPO_MAX_MV=2800
CONFIG_ZMK_NON_LIPO_LOW_MV=1900
